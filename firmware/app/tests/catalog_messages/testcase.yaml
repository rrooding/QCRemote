## firmware/app/tests/catalog_messages/testcase.yaml
```yaml
tests:
  firmware.catalog_messages:
    platform_allow: native_sim
    tags: firmware
```

## firmware/app/tests/dispatch_messages/testcase.yaml
```yaml
tests:
  firmware.dispatch_messages:
    platform_allow:
      - native_sim
      - qemu_cortex_m3
    tags: firmware
```

## firmware/app/tests/file_messages/testcase.yaml
```yaml
tests:
  firmware.file_messages:
    platform_allow:
      - native_sim
      - qemu_cortex_m3
    tags: firmware
```

## firmware/app/tests/gzip_inflate/testcase.yaml
```yaml
tests:
  firmware.gzip_inflate:
    platform_allow:
      - native_sim
      - qemu_cortex_m3
    tags: firmware
```

## firmware/app/tests/preset_catalog/testcase.yaml
```yaml
tests:
  firmware.preset_catalog:
    platform_allow:
      - native_sim
      - qemu_cortex_m3
    tags: firmware
```

## firmware/app/tests/protocol_messages/testcase.yaml
```yaml
tests:
  firmware.protocol_messages:
    platform_allow: native_sim
    tags: firmware
```
